## boards/shields/obiwanstenobit/Kconfig.defconfig
```kconfig
if SHIELD_OBIWANSTENOBIT

config ZMK_KEYBOARD_NAME
    default "OBIWANSTENOBIT"

endif
```

## boards/shields/obiwanstenobit/Kconfig.shield
```kconfig
config SHIELD_OBIWANSTENOBIT
    def_bool $(shields_list_contains,obiwanstenobit)
```
